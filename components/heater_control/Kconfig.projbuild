## components/heater_control/Kconfig.projbuild
```kconfig
menu "Heater and resistance measurement"
    config HEATER_OUTPUT_DUTY_LIMIT
        int "Maximum permitted heater duty"
        range 0 95
        default 2
        help
            Reject START/SET above this limit and prevent PWM application above
            it. Keep at 2 during hardware validation; increasing needs explicit
            approval and validation for the attached heater hardware.
    config HEATER_CONTROL_LEASE_MS
        int "SET/PING control lease (milliseconds)"
        range 1000 30000
        default 5000
        help
            A controlling host sends PING every second. Lease expiry cancels
            heating while measurements continue. PING never starts heating.
    config HEATER_MAX_ISR_LATENCY_US
        int "Maximum accepted phase interrupt lateness (us)"
        range 10 80
        default 50
        help
            A late phase closes both request signals and skips to the next
            absolute 20 ms boundary. Validate this limit on the real board.
    config HEATER_VALID_MIN_MOHM
        int "Lowest plausible resistance (milliohms)"
        range 1 159999
        default 90000
        help
            This guard includes noise around the nominal 100-160 ohm range.
            Invalid samples inhibit heating for that channel next cycle.
    config HEATER_VALID_MAX_MOHM
        int "Highest plausible resistance (milliohms)"
        range 160001 249999
        default 180000
    config HEATER_REFERENCE_1_MOHM
        int "Channel 1 calibrated reference resistance (milliohms)"
        range 900000 1100000
        default 1000000
    config HEATER_REFERENCE_2_MOHM
        int "Channel 2 calibrated reference resistance (milliohms)"
        range 900000 1100000
        default 1000000
    config HEATER_REFERENCE_3_MOHM
        int "Channel 3 calibrated reference resistance (milliohms)"
        range 900000 1100000
        default 1000000
    config HEATER_REFERENCE_4_MOHM
        int "Channel 4 calibrated reference resistance (milliohms)"
        range 900000 1100000
        default 1000000
    config HEATER_OFFSET_1_MOHM
        int "Channel 1 resistance correction (milliohms)"
        range -10000 10000
        default 0
    config HEATER_OFFSET_2_MOHM
        int "Channel 2 resistance correction (milliohms)"
        range -10000 10000
        default 0
    config HEATER_OFFSET_3_MOHM
        int "Channel 3 resistance correction (milliohms)"
        range -10000 10000
        default 0
    config HEATER_OFFSET_4_MOHM
        int "Channel 4 resistance correction (milliohms)"
        range -10000 10000
        default 0
endmenu
```

## components/heater_runtime/Kconfig.projbuild
```kconfig
# 加热测量的时序与校准配置；占空比范围由业务接口定义。
menu "Heater and resistance measurement"
    config HEATER_CONTROL_LEASE_MS
        int "SET/PING control lease (milliseconds)"
        range 1000 30000
        default 5000
        help
            A controlling host sends PING every second. Lease expiry cancels
            heating while measurements continue. PING never starts heating.
    config HEATER_MAX_ISR_LATENCY_US
        int "Maximum accepted phase interrupt lateness (us)"
        range 10 80
        default 50
        help
            A late phase closes both request signals and skips to the next
            absolute 20 ms boundary. Validate this limit on the real board.
    config HEATER_VALID_MIN_MOHM
        int "Lowest plausible resistance (milliohms)"
        range 1 159999
        default 90000
        help
            This guard includes noise around the nominal 100-160 ohm range.
            Invalid samples inhibit heating for that channel next cycle.
    config HEATER_VALID_MAX_MOHM
        int "Highest plausible resistance (milliohms)"
        range 160001 249999
        default 180000
    config HEATER_REFERENCE_1_MOHM
        int "Channel 1 calibrated reference resistance (milliohms)"
        range 900000 1100000
        default 1000000
    config HEATER_REFERENCE_2_MOHM
        int "Channel 2 calibrated reference resistance (milliohms)"
        range 900000 1100000
        default 1000000
    config HEATER_REFERENCE_3_MOHM
        int "Channel 3 calibrated reference resistance (milliohms)"
        range 900000 1100000
        default 1000000
    config HEATER_REFERENCE_4_MOHM
        int "Channel 4 calibrated reference resistance (milliohms)"
        range 900000 1100000
        default 1000000
    config HEATER_OFFSET_1_MOHM
        int "Channel 1 resistance correction (milliohms)"
        range -10000 10000
        default 0
    config HEATER_OFFSET_2_MOHM
        int "Channel 2 resistance correction (milliohms)"
        range -10000 10000
        default 0
    config HEATER_OFFSET_3_MOHM
        int "Channel 3 resistance correction (milliohms)"
        range -10000 10000
        default 0
    config HEATER_OFFSET_4_MOHM
        int "Channel 4 resistance correction (milliohms)"
        range -10000 10000
        default 0
endmenu
```
